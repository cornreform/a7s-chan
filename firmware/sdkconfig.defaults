## firmware/sdkconfig.defaults
```kconfig
# ESP32-S3 M5Stack CoreS3 — proper configuration
CONFIG_IDF_TARGET="esp32s3"
CONFIG_IDF_FIRMWARE_CHIP_ID=0x9

# CPU
CONFIG_ESP32S3_DEFAULT_CPU_FREQ_240=y

# PSRAM — CoreS3 uses Quad PSRAM (not Octal)
CONFIG_ESP32S3_SPIRAM_SUPPORT=y
CONFIG_SPIRAM=y
# No Octal PSRAM — this is Quad PSRAM
# CONFIG_ESP32S3_OCT_PSRAM is not set
CONFIG_SPIRAM_SPEED_80M=y
CONFIG_SPIRAM_USE_CAPS_ALLOC=y
CONFIG_SPIRAM_IGNORE_NOTFOUND=y

# Flash
CONFIG_ESPTOOLPY_FLASHMODE_QIO=y
CONFIG_ESPTOOLPY_FLASHFREQ_80M=y
CONFIG_ESPTOOLPY_FLASHSIZE_16MB=y

# Partition table
CONFIG_PARTITION_TABLE_CUSTOM=y
CONFIG_PARTITION_TABLE_CUSTOM_FILENAME="partitions.csv"

# WiFi
CONFIG_ESP_WIFI_ENABLED=y
CONFIG_ESP_WIFI_STATIC_RX_BUFFER_NUM=16
CONFIG_ESP_WIFI_DYNAMIC_RX_BUFFER_NUM=32
CONFIG_ESP_WIFI_TX_BUFFER_TYPE=1
CONFIG_ESP_WIFI_DYNAMIC_TX_BUFFER_NUM=32
CONFIG_ESP_WIFI_RX_BA_WIN=6
CONFIG_ESP_WIFI_TASK_CORE_ID=1
CONFIG_ESP_WIFI_SOFTAP_BEACON_MAX_LEN=512

# LWIP
CONFIG_LWIP_LOCAL_HOSTNAME="stack-chan"

# FreeRTOS
CONFIG_FREERTOS_HZ=1000
CONFIG_FREERTOS_USE_TICKLESS_IDLE=n
CONFIG_FREERTOS_TASK_FUNCTION_WRAPPER=y

# Compiler
CONFIG_COMPILER_OPTIMIZATION_PERF=y
CONFIG_COMPILER_OPTIMIZATION_ASSERTIONS_ENABLE=y
CONFIG_ESP_MAIN_TASK_STACK_SIZE=8192

# Logging
CONFIG_LOG_MAXIMUM_LEVEL=4
CONFIG_LOG_COLORS=y

# RMT
CONFIG_RMT_ENABLE_DEBUG_LOG=n

# I2S
CONFIG_I2S_ENABLE_DEBUG_LOG=n

# LWIP UDP
CONFIG_LWIP_UDP=y

# MDNS
CONFIG_MDNS_ENABLE_SERVICE_PRINT=n
```
